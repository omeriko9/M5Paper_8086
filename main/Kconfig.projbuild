## main/Kconfig.projbuild
```kconfig
menu "M5Paper DOS Configuration"

    choice EBOOK_DEVICE
        prompt "Target Device"
        default EBOOK_DEVICE_M5PAPER
        help
            Select the target M5Paper device variant.

        config EBOOK_DEVICE_M5PAPER
            bool "M5Paper (ESP32)"
            help
                Original M5Paper with ESP32 and IT8951 EPD controller.
                
        config EBOOK_DEVICE_M5PAPERS3
            bool "M5PaperS3 (ESP32-S3)"
            help
                M5PaperS3 with ESP32-S3 and built-in speaker.
    endchoice

    config M5PAPER_SPEAKER_ENABLED
        bool "Enable PC Speaker emulation"
        default y if EBOOK_DEVICE_M5PAPERS3
        default n if EBOOK_DEVICE_M5PAPER
        help
            Enable PC speaker/buzzer emulation using the device's speaker.
            M5PaperS3 has a built-in speaker that can be used for this.
            Original M5Paper does not have a speaker.

    config M5PAPER_SPEAKER_VOLUME
        int "Speaker volume (0-255)"
        default 128
        range 0 255
        depends on M5PAPER_SPEAKER_ENABLED
        help
            Default speaker volume for PC speaker emulation.

endmenu
```

## sdkconfig.defaults
```kconfig
# CPU Performance
CONFIG_ESP_DEFAULT_CPU_FREQ_MHZ_240=y
CONFIG_ESP_DEFAULT_CPU_FREQ_MHZ=240
CONFIG_ESP32_DEFAULT_CPU_FREQ_240=y
CONFIG_ESP32_DEFAULT_CPU_FREQ_MHZ=240
CONFIG_ESP32S3_DEFAULT_CPU_FREQ_240=y
CONFIG_ESP32S3_DEFAULT_CPU_FREQ_MHZ=240

# SPIRAM
CONFIG_ESP32_SPIRAM_SUPPORT=y
CONFIG_ESP32S3_SPIRAM_SUPPORT=y
CONFIG_SPIRAM_USE_MALLOC=y
CONFIG_SPIRAM_TYPE_AUTO=y
CONFIG_SPIRAM_SPEED_40M=y
CONFIG_ESP_TASK_WDT=y
CONFIG_BT_ENABLED=y
CONFIG_BTDM_CTRL_MODE_BLE_ONLY=y
CONFIG_BT_BLUEDROID_ENABLED=y
CONFIG_BT_BLE_ENABLED=y
CONFIG_BT_BLE_42_FEATURES_SUPPORTED=y
CONFIG_BT_GATTC_NOTIF_REG_MAX=16
# CONFIG_PARTITION_TABLE_SINGLE_APP is not set
CONFIG_PARTITION_TABLE_SINGLE_APP_LARGE=y
CONFIG_PARTITION_TABLE_CUSTOM=y
CONFIG_PARTITION_TABLE_CUSTOM_FILENAME="partitions.csv"
CONFIG_PARTITION_TABLE_FILENAME="partitions.csv"
# CONFIG_LOG_IN_IRAM is not set
# CONFIG_ESP_TIMER_IN_IRAM is not set
# CONFIG_ESP_EVENT_POST_FROM_IRAM_ISR is not set
# CONFIG_ESP_INTR_IN_IRAM is not set
# CONFIG_ESP_ROM_PRINT_IN_IRAM is not set
# CONFIG_POST_EVENTS_FROM_IRAM_ISR is not set
# CONFIG_SPIRAM_CACHE_LIBJMP_IN_IRAM is not set
# CONFIG_SPIRAM_CACHE_LIBMATH_IN_IRAM is not set
# CONFIG_SPIRAM_CACHE_LIBNUMPARSER_IN_IRAM is not set
# CONFIG_SPIRAM_CACHE_LIBIO_IN_IRAM is not set
# CONFIG_SPIRAM_CACHE_LIBTIME_IN_IRAM is not set
# CONFIG_SPIRAM_CACHE_LIBCHAR_IN_IRAM is not set
CONFIG_SPIRAM_CACHE_LIBMEM_IN_IRAM=y
CONFIG_SPIRAM_CACHE_LIBSTR_IN_IRAM=y
# CONFIG_SPIRAM_CACHE_LIBRAND_IN_IRAM is not set
# CONFIG_SPIRAM_CACHE_LIBENV_IN_IRAM is not set
# CONFIG_SPIRAM_CACHE_LIBFILE_IN_IRAM is not set
# CONFIG_SPIRAM_CACHE_LIBMISC_IN_IRAM is not set
CONFIG_COMPILER_OPTIMIZATION_PERF=y
CONFIG_COMPILER_DISABLE_GCC14_WARNINGS=y
CONFIG_COMPILER_DISABLE_DEFAULT_ERRORS=y

# Increase main task stack (app_main) to avoid early stack overflow during init.
CONFIG_ESP_MAIN_TASK_STACK_SIZE=6144
```
